/ {
  chosen {
    zmk,kscan = &kscan0;
    zmk,split-role = "peripheral";
  };

  kscan0: kscan {
    compatible = "zmk,kscan-gpio";
    diode-direction = "col2row";
    rows = <4>;
    cols = <5>;

    row-gpios = <&gpio0 4 GPIO_ACTIVE_HIGH>,
                <&gpio0 5 GPIO_ACTIVE_HIGH>,
                <&gpio0 6 GPIO_ACTIVE_HIGH>,
                <&gpio0 7 GPIO_ACTIVE_HIGH>;

    col-gpios = <&gpio0 20 GPIO_ACTIVE_HIGH>,
                <&gpio0 19 GPIO_ACTIVE_HIGH>,
                <&gpio0 18 GPIO_ACTIVE_HIGH>,
                <&gpio0 15 GPIO_ACTIVE_HIGH>,
                <&gpio0 14 GPIO_ACTIVE_HIGH>;
  };
};
